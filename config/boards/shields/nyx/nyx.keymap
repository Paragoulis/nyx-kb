#include <behaviors.dtsi>
#include <behaviors/num_word.dtsi> // Requires zmk-auto-layer module.
#include <behaviors/unicode.dtsi> // Requires zmk-unicode module.
#include <zmk-helpers/helper.h> // Requires zmk-helpers module.
#include <dt-bindings/zmk/keys.h>
#include "keys_hu.h"
#include "keypos_64keys.h"
#include <dt-bindings/zmk/bt.h>
#include <dt-bindings/zmk/outputs.h>

#define DEF 0
#define NAV 1
#define FN 2
#define NUM 3
#define MOUSE 4

#define XXX &none
#define ___ &trans


/* Global defaults */

#define QUICK_TAP_MS 175

&sk {
  release-after-ms = <900>;
  quick-release;
};

&sl { // Allow sticky mods to chord across sticky layers.
  ignore-modifiers;
};

&lt {
  flavor = "balanced";
  tapping-term-ms = <200>;
  quick-tap-ms = <QUICK_TAP_MS>;
};

/* Homerow mods */

#define KEYS_L LN0 LN1 LN2 LN3 LN4 LN5 LN6 LT0 LT1 LT2 LT3 LT4 LT5 LT6 LM0 LM1 LM2 LM3 LM4 LM5 LM6 LB0 LB1 LB2 LB3 LB4 LB5 LB6  // left hand
#define KEYS_R RN0 RN1 RN2 RN3 RN4 RN5 RN6 RT0 RT1 RT2 RT3 RT4 RT5 RT6 RM0 RM1 RM2 RM3 RM4 RM5 RM6 RB0 RB1 RB2 RB3 RB4 RB5 RB6  // right hand
#define THUMBS LH3 LH2 LH1 LH0 RH0 RH1 RH2 RH3                                     // thumbs

#define MAKE_HRM(NAME, HOLD, TAP, TRIGGER_POS)                                 \
  ZMK_HOLD_TAP(NAME, bindings = <HOLD>, <TAP>; flavor = "balanced";            \
               tapping-term-ms = <280>; quick-tap-ms = <QUICK_TAP_MS>;         \
               require-prior-idle-ms = <150>; hold-trigger-on-release;         \
               hold-trigger-key-positions = <TRIGGER_POS>;)

MAKE_HRM(hml, &kp, &kp, KEYS_R THUMBS) // Left-hand HRMs.
MAKE_HRM(hmr, &kp, &kp, KEYS_L THUMBS) // Right-hand HRMs.

// Hack: Make HRM combos tap-only (cf, ZMK issue #544).
#define ZMK_COMBO_8(NAME, TAP, POS, LAYERS, COMBO_MS, IDLE_MS, HOLD, SIDE)     \
  MAKE_HRM(hm_combo_##NAME, &kp, TAP, SIDE THUMBS)                             \
  ZMK_COMBO_6(NAME, &hm_combo_##NAME HOLD 0, POS, LAYERS, COMBO_MS, IDLE_MS)

/* Combos, leader key sequences, mouse emulation */

#include "combos.dtsi" // Must be sourced after HRM-combo hack.
#include "leader.dtsi"
#include "mouse.dtsi"

/* Nav cluster */

// Trigger tap-action on all interrupts.
#define MT_CORE                                                                \
  flavor = "tap-preferred";                                                    \
  tapping-term-ms = <220>;                                                     \
  quick-tap-ms = <220>;                                                        \
  hold-trigger-key-positions = <0>;

&mt { MT_CORE };

ZMK_HOLD_TAP(mt_home, bindings = <&masked_home>, <&kp>; MT_CORE)
ZMK_HOLD_TAP(mt_end, bindings = <&masked_end>, <&kp>; MT_CORE)

#define NAV_LEFT  &mt_home 0   LEFT  // Tap: left  | Long-tap: start of line.
#define NAV_RIGHT &mt_end 0    RIGHT // Tap: right | Long-tap: end   of line.
#define NAV_UP    &mt LC(HOME) UP    // Tap: up    | Long-tap: start of doc.
#define NAV_DOWN  &mt LC(END)  DOWN  // Tap: down  | Long-tap: end   of doc.
#define NAV_BSPC  &mt LC(BSPC) BSPC  // Tap: bspc  | Long-tap: delete word bwd.
#define NAV_DEL   &mt LC(DEL)  DEL   // Tap: del   | Long-tap: delete word fwd.

// Mask CTRL on left/right hold to avoid accidental jumps to start/end of doc.
#define MASK_MODS(NAME, MODS, BINDING)                                         \
  ZMK_MOD_MORPH(NAME, bindings = <BINDING>, <BINDING>; mods = <MODS>;)

MASK_MODS(masked_home, (MOD_LCTL), &kp HOME)
MASK_MODS(masked_end,  (MOD_LCTL), &kp END)

/* Magic-shift & auto-layers */

// Tap: repeat after alpha, else sticky-shift |
// Shift + tap/ double-tap: caps-word | Hold: shift.
#define MAGIC_SHIFT &magic_shift LSHFT 0
ZMK_HOLD_TAP(magic_shift, bindings = <&kp>, <&magic_shift_tap>;
             flavor = "balanced"; tapping-term-ms = <200>;
             quick-tap-ms = <QUICK_TAP_MS>;)
ZMK_MOD_MORPH(magic_shift_tap, bindings = <&shift_repeat>, <&caps_word>;
              mods = <(MOD_LSFT)>;)
ZMK_ADAPTIVE_KEY(
    shift_repeat, bindings = <&sk LSHFT>;
    repeat {
      trigger-keys = <A B C D E F G H I J K L M N O P Q R S T U V W X Y Z>;
      bindings = <&key_repeat>;
      max-prior-idle-ms = <1200>;
      strict-modifiers;
    };)
&caps_word { // Mods deactivate caps-word, requires PR #1451. [TODO: rebase]
  /delete-property/ ignore-modifiers;
};

// Tap: num-word | double-tap: sticky num-layer | Hold: num-layer.
#define SMART_NUM &smart_num NUM 0
ZMK_HOLD_TAP(smart_num, bindings = <&mo>, <&num_dance>; flavor = "balanced";
             tapping-term-ms = <200>; quick-tap-ms = <QUICK_TAP_MS>;)
ZMK_TAP_DANCE(num_dance, bindings = <&num_word NUM>, <&sl NUM>;
              tapping-term-ms = <200>;)

// Smart-mouse, requires tri-state module.
ZMK_TRI_STATE(
    smart_mouse, bindings = <&tog MOUSE>, <&none>, <&tog MOUSE>;
    ignored-key-positions =
        <LT1 LT2 LH0 LH1 RT1 RT2 RT3 RM0 RM1 RM2 RM3 RM4 RM5 RB1 RB2 RB3 RB4 RB5 RH1 RH2 RH3>;
    ignored-layers = <MOUSE NAV FN>;)

/* Custom behaviors */

// Alt+Tab swapper, requires tri-state module.
ZMK_TRI_STATE(swapper, bindings = <&kt LALT>, <&kp TAB>, <&kt LALT>;
              ignored-key-positions = <LT2 RT2 RM1 RM2 RM3>;)

// Define mod-morph with a *single* mod trigger for less repetition.
#define SIMPLE_MORPH(NAME, MOD, BINDING1, BINDING2)                            \
  ZMK_MOD_MORPH(NAME, mods = <(MOD_L##MOD | MOD_R##MOD)>;                      \
                bindings = <BINDING1>, <BINDING2>;)

// Tap: comma | Shift + tap: semicolon.
SIMPLE_MORPH(comma_morph, SFT, &kp HU_COMMA, &kp HU_SEMICOLON)

// Tap: dot | Shift + tap: colon.
SIMPLE_MORPH(dot_morph, SFT, &kp HU_DOT, &kp HU_COLON)

// Tap: qmark | Shift + tap: excl.
SIMPLE_MORPH(qexcl, SFT, &kp HU_QMARK, &kp HU_EXCL)

// Tap: HU_O_UMLAUT | Ctrl + tap: HU_O_DOUBLE_ACUTE.
SIMPLE_MORPH(huou, CTL, &kp HU_O_UMLAUT, &kp HU_O_DOUBLE_ACUTE)

// Tap: HU_U_UMLAUT | Ctrl + tap: HU_DOUBLE_ACUTE.
SIMPLE_MORPH(huuu, CTL, &kp HU_U_UMLAUT, &kp HU_U_DOUBLE_ACUTE)

// Tap: A | Ctrl + tap: HU_A_ACUTE.
SIMPLE_MORPH(huaa, CTL, &kp A, &kp HU_A_ACUTE)

// Tap: U | Ctrl + tap: HU_U_ACUTE.
SIMPLE_MORPH(huua, CTL, &kp U, &kp HU_U_ACUTE)

// Tap: left/right parenthesis | Shft + tap: less-than/greater-than.
SIMPLE_MORPH(lpar_lt, SFT, &kp HU_LPAR, &kp HU_LT)
SIMPLE_MORPH(rpar_gt, SFT, &kp HU_RPAR, &kp HU_GT)

// Tap: space | Shift + tap: dot -> space -> sticky shift | Hold: nav layer.
ZMK_HOLD_TAP(lt_spc, bindings = <&mo>, <&spc_morph>; flavor = "balanced";
             tapping-term-ms = <200>; quick-tap-ms = <QUICK_TAP_MS>;)
SIMPLE_MORPH(spc_morph, SFT, &kp SPACE, &dot_spc)
ZMK_MACRO(dot_spc, bindings = <&kp DOT &kp SPACE &sk LSHFT>; wait-ms = <0>;
          tap-ms = <5>;)

// Tap: copy | double-tap: cut.
ZMK_TAP_DANCE(copy_cut, bindings = <&kp LC(INS)>, <&kp LC(X)>;
              tapping-term-ms = <200>;)

// Sticky shift + leader.
ZMK_MACRO(leader_sft, bindings = <&sk LSHFT &leader>;)

/* Keymap */

/ {
    keymap {
        compatible = "zmk,keymap";

        default_layer {
            bindings = <
&trans          &trans  &trans       &trans            &trans          &trans         &trans          &trans    &trans   &trans        &trans        &trans      &trans        &trans
&kp HU_E_ACUTE  &kp Q   &kp W        &kp F             &kp P           &kp B          &trans          &trans    &kp J    &kp L         &huua         &kp Y       &huuu         &kp HU_O_ACUTE
&kp HU_A_ACUTE  &kp A   &hml LALT R  &hml LCTRL S      &hml LSHFT T    &kp G          &trans          &trans    &kp M    &hmr RSHFT N  &hmr RCTRL E  &hmr RALT I &hmr LGUI O   &huou
&kp HU_I_ACUTE  &kp Z   &kp X        &kp D             &kp C           &kp V          &trans          &trans    &kp K    &kp H         &comma_morph  &dot_morph  &qexcl        &kp HU_MINUS
                                     &kp LGUI      &lt_spc NAV 0     &smart_mouse    &trans          &trans    &lt FN RET  SMART_NUM  MAGIC_SHIFT
		    >;
        };

	nav_layer {
            bindings = <
&trans  ___              ___       ___         ___        ___     &trans    &trans     ___            ___         ___        ___        ___        ___
&trans  &kp LA(F4)       &trans    &kp LS(TAB) &swapper   &trans  &trans    &trans     &trans         &kp HOME    &kp PG_DN  &kp PG_UP  &kp END    ___
&trans  &sk LGUI         &sk LALT  &sk LCTRL   &sk LSHFT  &trans  &trans    &trans     &trans         NAV_LEFT    NAV_DOWN   NAV_UP     NAV_RIGHT  &trans
&trans  &kp PRINTSCREEN  &trans    &trans      &trans     &trans  &trans    &trans     &trans         &kp INS     &kp TAB    &trans     &trans     &trans
                            &trans       &trans     &trans  &trans    ___        &kp SPACE      NAV_BSPC    NAV_DEL
            >;
        };

        fn_layer {
            bindings = <
&trans     &trans        &trans         &trans           &trans         &trans   &trans      &trans  &trans  &trans      &trans        &trans        &trans    &trans
&trans     &kp F12       &kp F7         &kp F8           &kp F9         &trans   &trans      &trans  &trans  &trans      &trans        &trans        &trans    &trans
&trans     &hml LGUI F11 &hml LALT F4   &hml LSHIFT F5   &hml LCTRL F6  &trans   &trans      &trans  &trans  &kp C_MUTE  &kp C_VOL_DN  &kp C_VOL_UP  &trans    &trans
&trans     &kp F10       &kp F1         &kp F2           &kp F3         &trans   &trans      &trans  &trans  &trans      &trans        &trans        &trans    &trans
                                        &trans           &trans         &trans   &trans      &trans  &trans  &kp C_PP    &trans
            >;
        };

        num_layer {
            bindings = <
&trans  &trans        &trans  &trans  &trans     &trans   &trans    &trans  &trans  &trans     &trans     &trans    &trans    &trans
&trans  &trans        &kp N7  &kp N4  &kp N1     &trans   &trans    &trans  &trans  &trans     &trans     &trans    &trans    &trans
&trans  &trans        &kp N8  &kp N5  &kp N2     &trans   &trans    &trans  &trans  &kp RSHFT  &kp RCTRL  &kp RALT  &kp RGUI  &trans
&trans  &trans        &kp N9  &kp N6  &kp N3     &trans   &trans    &trans  &trans  &trans     &trans     &trans    &trans    &trans
                              &trans  &kp HU_N0  &trans   &trans    &trans  &trans  &trans     &trans
            >;
        };

        mouse_layer {
            bindings = <
&trans  &trans    &trans    &trans     &trans     &trans  &trans    &trans  &trans     &trans     &trans   &trans  &trans     &trans
&trans  &trans    &trans    &trans     &trans     &trans  &trans    &trans  &trans     &kp PG_UP  &trans   &trans  &kp PG_DN  &trans
&trans  &kp LGUI  &kp LALT  &kp LCTRL  &kp LSHFT  &trans  &trans    &trans  &trans     U_MS_L     U_MS_D   U_MS_U  U_MS_R     &trans
&trans  &trans    &trans    &trans     &trans     &trans  &trans    &trans  &trans     U_WH_L     U_WH_D   U_WH_U  U_WH_D     &trans
                            &trans     &trans     &trans  &trans    &trans  &mkp LCLK  &mkp MCLK  &mkp RCLK
            >;
        };

        upper_layer {
            // |          |            |            |            |            |            |      |      |      |      |      |      |      |      |
            // | BT_CLR   | BT_SEL 0   | BT_SEL 1   | BT_SEL 2   | BT_SEL 3   | BT_SEL 4   |      |      |      |      |      |      |      |      |
            // |          |            |            |            |            |            |      |      |      |      |      |      |      |      |
            // |          |            |            |            |            |            |      |      |      |      |      |      |      |      |
            // |          |            |            |            |            |            |      |      |      |      |      |      |      |      |

            bindings = <
&trans      &trans        &trans        &trans        &trans        &trans        &trans    &trans  &trans  &trans  &trans  &trans  &trans  &trans
&bt BT_CLR  &bt BT_SEL 0  &bt BT_SEL 1  &bt BT_SEL 2  &bt BT_SEL 3  &bt BT_SEL 4  &trans    &trans  &trans  &trans  &trans  &trans  &trans  &trans
&trans      &trans        &trans        &trans        &trans        &trans        &trans    &trans  &trans  &trans  &trans  &trans  &trans  &trans
&trans      &trans        &trans        &trans        &trans        &trans        &trans    &trans  &trans  &trans  &trans  &trans  &trans  &trans
                                        &trans        &trans        &trans        &trans    &trans  &trans  &trans  &trans
            >;
        };
    };

    combos {
        compatible = "zmk,combos";

        combo_upperl {
            timeout-ms = <50>;
            key-positions = <56 57>;
            bindings = <&mo 5>;
        };

        combo_upperr {
            timeout-ms = <50>;
            key-positions = <62 63>;
            bindings = <&mo 5>;
        };
    };
};
